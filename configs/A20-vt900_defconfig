## configs/A20-vt900_defconfig
```kconfig
CONFIG_ARM=y
CONFIG_ARCH_SUNXI=y
CONFIG_NR_DRAM_BANKS=1
CONFIG_SPL=y
CONFIG_MACH_SUN7I=y
CONFIG_DRAM_CLK=432
CONFIG_MMC0_CD_PIN="PH10"
CONFIG_MMC1_PINS="PC"
CONFIG_MMC_SUNXI_SLOT_EXTRA=2
CONFIG_INITIAL_USB_SCAN_DELAY=100
CONFIG_USB0_VBUS_PIN="PB9"
CONFIG_USB0_VBUS_DET="PH13"
CONFIG_USB0_ID_DET="PH11"
CONFIG_USB1_VBUS_PIN="PH14"
CONFIG_USB2_VBUS_PIN="PH15"
CONFIG_I2C4_ENABLE=y
CONFIG_VIDEO_COMPOSITE=y
CONFIG_AHCI=y
# CONFIG_SYS_MALLOC_CLEAR_ON_INIT is not set
CONFIG_ANDROID_BOOT_IMAGE=y
CONFIG_USE_PREBOOT=y
CONFIG_SPL_I2C_SUPPORT=y
# CONFIG_BOOTM_NETBSD is not set
# CONFIG_BOOTM_PLAN9 is not set
# CONFIG_BOOTM_RTEMS is not set
# CONFIG_BOOTM_VXWORKS is not set
# CONFIG_CMD_ELF is not set
CONFIG_CMD_UNZIP=y
CONFIG_CMD_SATA=y
# CONFIG_SPL_DOS_PARTITION is not set
# CONFIG_SPL_EFI_PARTITION is not set
CONFIG_DEFAULT_DEVICE_TREE="sun7i-a20-vt900"
CONFIG_SYS_RELOC_GD_ENV_ADDR=y
CONFIG_NETCONSOLE=y
CONFIG_SCSI_AHCI=y
CONFIG_LED=y
CONFIG_LED_BLINK=y
CONFIG_LED_GPIO=y
CONFIG_PHY_ADDR=0
CONFIG_ETH_DESIGNWARE=y
CONFIG_MII=y
CONFIG_SUN7I_GMAC=y
CONFIG_SUN7I_GMAC_FORCE_TXERR=y
CONFIG_SCSI=y
CONFIG_USB_EHCI_HCD=y
CONFIG_USB_OHCI_HCD=y
CONFIG_USB_MUSB_HOST=y
CONFIG_SYS_USB_EVENT_POLL_VIA_INT_QUEUE=y
# CONFIG_USB_GADGET is not set
```

## configs/A40i_Forlinx_OKA40i_fel_defconfig
```kconfig
CONFIG_ARM=y
CONFIG_SYS_L2CACHE_OFF=y
CONFIG_ARCH_SUNXI=y
# CONFIG_SPL_MMC_SUPPORT is not set
CONFIG_SPL=y
CONFIG_MACH_SUN8I_R40=y
CONFIG_DRAM_SUN8I_R40_AWLIB=y
CONFIG_MMC0_CD_PIN="PI11"
CONFIG_MMC3_CD_PIN="PI10"
CONFIG_MMC1_PINS="PG"
CONFIG_MMC2_PINS="PC"
CONFIG_MMC3_PINS="PI"
CONFIG_MMC_SUNXI_SLOT_EXTRA=2
CONFIG_INITIAL_USB_SCAN_DELAY=100
CONFIG_USB0_VBUS_PIN="PI13"
CONFIG_USB0_VBUS_DET="PH17"
CONFIG_USB0_ID_DET="PH21"
CONFIG_USB2_VBUS_PIN="PB12"
CONFIG_AHCI=y
# CONFIG_SYS_MALLOC_CLEAR_ON_INIT is not set
CONFIG_TOOLS_DEBUG=y
# CONFIG_DISPLAY_CPUINFO is not set
CONFIG_SPL_I2C_SUPPORT=y
CONFIG_SPL_RAM_SUPPORT=y
# CONFIG_BOOTM_PLAN9 is not set
# CONFIG_BOOTM_RTEMS is not set
# CONFIG_BOOTM_VXWORKS is not set
CONFIG_CMD_MEMINFO=y
CONFIG_CMD_MEMTEST=y
CONFIG_SYS_ALT_MEMTEST=y
CONFIG_SYS_MEMTEST_START=0x50000000
CONFIG_SYS_MEMTEST_END=0x54000000
CONFIG_CMD_LZMADEC=y
CONFIG_CMD_UNZIP=y
# CONFIG_CMD_PINMUX is not set
CONFIG_CMD_SATA=y
CONFIG_CMD_REGULATOR=y
CONFIG_SPL_DOS_PARTITION=y
CONFIG_SPL_EFI_PARTITION=y
CONFIG_DEFAULT_DEVICE_TREE="sun8i-a40i-forlinx-oka40i"
CONFIG_NET_RANDOM_ETHADDR=y
CONFIG_SCSI_AHCI=y
CONFIG_CPU=y
CONFIG_LED=y
CONFIG_LED_BLINK=y
CONFIG_LED_GPIO=y
# CONFIG_PHY_ADDR_ENABLE is not set
CONFIG_ETH_DESIGNWARE=y
CONFIG_MII=y
CONFIG_SUN8I_EMAC=y
CONFIG_PINCTRL=y
CONFIG_PINCONF=y
CONFIG_DM_REGULATOR=y
CONFIG_DM_REGULATOR_FIXED=y
CONFIG_AXP_DCDC2_VOLT=1160
CONFIG_AXP_DCDC3_VOLT=1200
CONFIG_AXP_DCDC4_VOLT=1100
CONFIG_AXP_ALDO1_VOLT=2800
CONFIG_AXP_ALDO2_VOLT=1800
CONFIG_AXP_DLDO1_VOLT=3300
CONFIG_AXP_DLDO2_VOLT=3300
CONFIG_AXP_DLDO3_VOLT=3300
CONFIG_AXP_DLDO4_VOLT=2500
CONFIG_AXP_ELDO1_VOLT=2800
CONFIG_AXP_ELDO2_VOLT=1200
CONFIG_AXP_ELDO3_VOLT=2800
CONFIG_SCSI=y
CONFIG_USB_EHCI_HCD=y
CONFIG_USB_OHCI_HCD=y
CONFIG_USB_MUSB_PIO_ONLY=y
# CONFIG_USB_GADGET is not set
# CONFIG_SYS_WHITE_ON_BLACK is not set
CONFIG_SPL_TINY_MEMSET=y
CONFIG_TPL_TINY_MEMSET=y
# CONFIG_OF_LIBFDT_OVERLAY is not set
```
